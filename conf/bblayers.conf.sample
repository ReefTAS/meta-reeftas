## conf/bblayers.conf.sample
```bitbake
# POKY_BBLAYERS_CONF_VERSION is increased each time build/conf/bblayers.conf
# changes incompatibly
POKY_BBLAYERS_CONF_VERSION = "2"

BBPATH = "${TOPDIR}"
BBFILES ?= ""

TOP = "${TOPDIR}/../.."
YOCTO_ROOT= "${TOP}/platform/yocto"

BBLAYERS ?= " \
    ${YOCTO_ROOT}/poky/meta \
    ${YOCTO_ROOT}/poky/meta-poky \
    ${YOCTO_ROOT}/meta-openembedded/meta-oe \
    ${YOCTO_ROOT}/meta-openembedded/meta-multimedia \
    ${YOCTO_ROOT}/meta-openembedded/meta-networking \
    ${YOCTO_ROOT}/meta-openembedded/meta-python \
    ${YOCTO_ROOT}/meta-nodejs \
    ${YOCTO_ROOT}/meta-nodejs-contrib \
    ${YOCTO_ROOT}/meta-raspberrypi \
    ${YOCTO_ROOT}/meta-go \
    ${YOCTO_ROOT}/meta-reeftas \
    ${YOCTO_ROOT}/meta-reeftas-raspberrypi \
    ${YOCTO_ROOT}/meta-reeftas-qemu/meta-reeftas-qemux86 \
"
```

## conf/layer.conf
```bitbake
BBPATH .= ":${LAYERDIR}"

# We have a recipes directory, add to BBFILES
BBFILES += "${LAYERDIR}/recipes*/*/*.bb ${LAYERDIR}/recipes*/*/*.bbappend ${LAYERDIR}/images/*.bb"

BBFILE_COLLECTIONS += "meta-reeftas"
BBFILE_PATTERN_meta-reeftas= "^${LAYERDIR}/"
BBFILE_PRIORITY_meta-reeftas= "10"

REEFTAS_DATADIR="/data/reeftas"
REEFTAS_DBDIR="${REEFTAS_DATADIR}/pgdata"
REEFTAS_DBPORT="5032"
REEFTAS_USER="reeftas"
REEFTAS_GROUP="reeftas"
```

## conf/local.conf.sample
```bitbake
# Local configuration for meta-rpi images
# Yocto Project 2.1 Poky distribution [krogoth] branch
# This is a sysvinit system

LICENSE_FLAGS_WHITELIST = "commercial"

DISTRO_FEATURES = "ext4 systemd usbhost ${DISTRO_FEATURES_LIBC}"

DISTRO_FEATURES_BACKFILL_CONSIDERED += "pulseaudio"

PREFERRED_PROVIDER_jpeg = "libjpeg-turbo"
PREFERRED_PROVIDER_jpeg-native = "libjpeg-turbo-native"

PREFERRED_PROVIDER_udev = "eudev"
VIRTUAL-RUNTIME_init_manager = "systemd"
DISTRO_FEATURES_BACKFILL_CONSIDERED = "sysvinit"

MACHINE_FEATURES_remove = "apm"

IMAGE_FSTYPES = "tar.xz wic"

DISTRO = "poky"

PACKAGE_CLASSES = "package_ipk"


EXTRA_IMAGE_FEATURES = "debug-tweaks"
USER_CLASSES = "image-mklibs image-prelink"
PATCHRESOLVE = "noop"
RM_OLD_IMAGE = "1"
CONF_VERSION = "1"
```
